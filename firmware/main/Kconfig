## firmware/main/Kconfig
```kconfig
menu "RGBW LED Controller Configuration"

    choice BOARD_TYPE
        prompt "Board Type"
        default BOARD_ESP32C3_NO_OLED
        help
            Select your board type. All other settings (GPIO, PWM frequency, etc.) 
            will be automatically configured for optimal performance.

        config BOARD_ESP32C3_OLED
            bool "ESP32-C3 with OLED (AL8860 driver)"
            help
                ESP32-C3 board with OLED display, optimized for AL8860 LED driver.
                
                Automatic settings:
                - PWM: 1000Hz, 8-bit resolution
                - GPIO: R=10, G=9, B=8, WW=7  
                - Max current: 1500mA per channel
                - Optimized for hysteretic control

        config BOARD_ESP32C3_NO_OLED
            bool "ESP32-C3 without OLED (LM3414 driver)"
            help
                ESP32-C3 board without OLED display, optimized for LM3414 LED driver.
                
                Automatic settings:
                - PWM: 5000Hz, 12-bit resolution
                - GPIO: R=5, G=6, B=7, WW=8
                - Max current: 1000mA per channel  
                - Optimized for precision control

    endchoice

    config MAX_BRIGHTNESS_PERCENT
        int "Maximum brightness limit (%)"
        range 1 100
        default 100
        help
            Set the maximum brightness limit as a percentage.
            The LED brightness sliders will map 0-100% to 0-[this value]%.
            This provides a global brightness limit for safety or power consumption.
            
            Examples:
            - 100%: No limit (full brightness available)
            - 80%: Limit to 80% of maximum possible brightness
            - 60%: Limit to 60% of maximum possible brightness
            
            This setting is applied at compile time. To change it later,
            you need to rebuild the firmware with a different value.

    config DEVICE_NAME
        string "BLE Device Name"
        default "RGBW_LED_001"
        help
            The BLE device name that will be advertised. Change this for each device.
            Examples: RGBW_LED_001, RGBW_LED_002, etc.

endmenu
```
